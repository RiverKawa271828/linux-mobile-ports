## Documentation/devicetree/bindings/input/awinic,aw8697.yaml
```yaml
# SPDX-License-Identifier: (GPL-2.0-only OR BSD-2-Clause)
%YAML 1.2
---
$id: http://devicetree.org/schemas/input/awinic,aw8697.yaml#
$schema: http://devicetree.org/meta-schemas/core.yaml#

title: Awinic AW8697 LRA Haptic IC

maintainers:
  - postmarketOS meizu20 port

properties:
  compatible:
    const: awinic,aw8697

  reg:
    maxItems: 1

  reset-gpios:
    maxItems: 1

  interrupts:
    maxItems: 1

required:
  - compatible
  - reg
  - reset-gpios
  - interrupts

additionalProperties: false

examples:
  - |
    #include <dt-bindings/gpio/gpio.h>
    #include <dt-bindings/interrupt-controller/irq.h>

    i2c {
        #address-cells = <1>;
        #size-cells = <0>;

        vibrator@5a {
            compatible = "awinic,aw8697";
            reg = <0x5a>;
            interrupts-extended = <&tlmm 99 IRQ_TYPE_LEVEL_HIGH>;
            reset-gpios = <&tlmm 109 GPIO_ACTIVE_LOW>;
        };
    };
```

## Documentation/devicetree/bindings/media/i2c/sony,imx563.yaml
```yaml
# SPDX-License-Identifier: (GPL-2.0-only OR BSD-2-Clause)
%YAML 1.2
---
$id: http://devicetree.org/schemas/media/i2c/sony,imx563.yaml#
$schema: http://devicetree.org/meta-schemas/core.yaml#

title: Sony IMX563 image sensor

maintainers:
  - Linux Media Mailing List <linux-media@vger.kernel.org>

description:
  The Sony IMX563 is a CMOS image sensor controlled over I2C. Image data is
  transmitted over a three-trio MIPI CSI-2 C-PHY interface.

allOf:
  - $ref: /schemas/media/video-interface-devices.yaml#

properties:
  compatible:
    const: sony,imx563

  reg:
    maxItems: 1

  clocks:
    maxItems: 1

  avdd-supply:
    description: Analog power supply.

  dvdd-supply:
    description: Digital core power supply.

  dovdd-supply:
    description: Digital I/O power supply.

  reset-gpios:
    description: Reference to the active-low XCLR pin.
    maxItems: 1

  port:
    additionalProperties: false
    $ref: /schemas/graph.yaml#/$defs/port-base

    properties:
      endpoint:
        $ref: /schemas/media/video-interfaces.yaml#
        unevaluatedProperties: false

        properties:
          bus-type:
            const: 1
          data-lanes:
            items:
              - const: 0
              - const: 1
              - const: 2
          link-frequencies:
            maxItems: 1

        required:
          - bus-type
          - data-lanes
          - link-frequencies

    required:
      - endpoint

required:
  - compatible
  - reg
  - clocks
  - avdd-supply
  - dvdd-supply
  - dovdd-supply
  - reset-gpios
  - port

unevaluatedProperties: false

examples:
  - |
    i2c {
        #address-cells = <1>;
        #size-cells = <0>;

        camera@1a {
            compatible = "sony,imx563";
            reg = <0x1a>;
            clocks = <&camera_clk>;
            avdd-supply = <&camera_avdd>;
            dvdd-supply = <&camera_dvdd>;
            dovdd-supply = <&camera_dovdd>;
            reset-gpios = <&gpio 117 1>;

            port {
                imx563_ep: endpoint {
                    bus-type = <1>;
                    data-lanes = <0 1 2>;
                    link-frequencies = /bits/ 64 <1507202083>;
                    remote-endpoint = <&csi_ep>;
                };
            };
        };
    };
...
```
